## resources/buildrootConf/custom_package/Config.in
```kconfig
menu "Custom Packages"
	source "$BR2_EXTERNAL_OPENWRT_INSTALLER_CUSTOM_PACKAGE_PATH/brush/Config.in"
	source "$BR2_EXTERNAL_OPENWRT_INSTALLER_CUSTOM_PACKAGE_PATH/debian-console-fonts/Config.in"
	source "$BR2_EXTERNAL_OPENWRT_INSTALLER_CUSTOM_PACKAGE_PATH/docbook-xsl/Config.in"
	source "$BR2_EXTERNAL_OPENWRT_INSTALLER_CUSTOM_PACKAGE_PATH/dotnet10/Config.in"
	source "$BR2_EXTERNAL_OPENWRT_INSTALLER_CUSTOM_PACKAGE_PATH/fdfind/Config.in"
	source "$BR2_EXTERNAL_OPENWRT_INSTALLER_CUSTOM_PACKAGE_PATH/gcc-standalone-toolchain/Config.in"
	source "$BR2_EXTERNAL_OPENWRT_INSTALLER_CUSTOM_PACKAGE_PATH/groff/Config.in"
	source "$BR2_EXTERNAL_OPENWRT_INSTALLER_CUSTOM_PACKAGE_PATH/hexedit/Config.in"
	source "$BR2_EXTERNAL_OPENWRT_INSTALLER_CUSTOM_PACKAGE_PATH/high-res-font-pack/Config.in"
	source "$BR2_EXTERNAL_OPENWRT_INSTALLER_CUSTOM_PACKAGE_PATH/jaq/Config.in"
	source "$BR2_EXTERNAL_OPENWRT_INSTALLER_CUSTOM_PACKAGE_PATH/kmscon/Config.in"
	source "$BR2_EXTERNAL_OPENWRT_INSTALLER_CUSTOM_PACKAGE_PATH/python-freetype-py/Config.in"
	source "$BR2_EXTERNAL_OPENWRT_INSTALLER_CUSTOM_PACKAGE_PATH/python-uv/Config.in"
	source "$BR2_EXTERNAL_OPENWRT_INSTALLER_CUSTOM_PACKAGE_PATH/pwsh7/Config.in"
	source "$BR2_EXTERNAL_OPENWRT_INSTALLER_CUSTOM_PACKAGE_PATH/sharutils/Config.in"
	source "$BR2_EXTERNAL_OPENWRT_INSTALLER_CUSTOM_PACKAGE_PATH/sudo-rs/Config.in"
	source "$BR2_EXTERNAL_OPENWRT_INSTALLER_CUSTOM_PACKAGE_PATH/terminus-font/Config.in"
	source "$BR2_EXTERNAL_OPENWRT_INSTALLER_CUSTOM_PACKAGE_PATH/uutils-coreutils/Config.in"
endmenu
```

## resources/buildrootConf/custom_package/brush/Config.in
```kconfig
config BR2_PACKAGE_BRUSH
	bool "brush"
	depends on BR2_PACKAGE_HOST_RUSTC_TARGET_ARCH_SUPPORTS
	depends on BR2_USE_MMU
	select BR2_PACKAGE_HOST_RUSTC
	help
	  POSIX and bash compatible shell written in Rust
	  (reubeno/brush). Installs /usr/bin/brush from the
	  brush-shell crate. Does not replace /bin/sh.

	  Tag brush-shell-v0.4.0 needs rustc >= 1.88. Default
	  cargo features are basic, reedline, and minimal.

	  https://github.com/reubeno/brush

if BR2_PACKAGE_BRUSH

config BR2_PACKAGE_BRUSH_VERSION
	string "brush version (GitHub tag without brush-shell-v)"
	default "0.4.0"
	help
	  Version from reubeno/brush without the brush-shell-v
	  prefix, for example 0.4.0. The download tag is
	  brush-shell-v$(BR2_PACKAGE_BRUSH_VERSION).

	  If brush.hash does not yet list that tag's tarball, its
	  sha256 is appended at download time.

config BR2_PACKAGE_BRUSH_DOCS
	bool "install brush man page and markdown docs"
	default y
	help
	  Download brush-docs.tar.gz from the matching GitHub
	  release and install man/brush.1 to /usr/share/man/man1
	  plus md/brush.md to /usr/share/doc/brush.

endif

comment "brush needs host rustc"
	depends on BR2_USE_MMU
	depends on !BR2_PACKAGE_HOST_RUSTC_TARGET_ARCH_SUPPORTS
```

## resources/buildrootConf/custom_package/debian-console-fonts/Config.in
```kconfig
config BR2_PACKAGE_DEBIAN_CONSOLE_FONTS
	bool "debian-console-fonts"
	depends on BR2_USE_MMU # kbd
	depends on BR2_TOOLCHAIN_GCC_AT_LEAST_4_9 # kbd
	select BR2_PACKAGE_KBD
	help
	  Linux console (PSF) fonts named and laid out the way Debian's
	  console-setup does (Uni2-Terminus16, Lat15-Fixed16,
	  Greek-VGA16, ...), built on the host from the fonts' original
	  sources by the Python tool of a debian-console-fonts release.
	  Only the .psf.gz files are installed, into
	  /usr/share/consolefonts. Pick the font faces and code sets
	  below.

	  https://github.com/btbutts/debian-console-fonts

if BR2_PACKAGE_DEBIAN_CONSOLE_FONTS

config BR2_PACKAGE_DEBIAN_CONSOLE_FONTS_VERSION
	string "debian-console-fonts release"
	default "0.0.4"
	help
	  Release of github.com/btbutts/debian-console-fonts, without the
	  leading v: the asset debian-console-fonts-<version>.tar.gz of
	  the release v<version>. Leave unset for the default.

comment "Font faces"

config BR2_PACKAGE_DEBIAN_CONSOLE_FONTS_TERMINUS
	bool "Terminus"
	default y
	help
	  Terminus by Dimitar Toshkov Zhekov (SIL OFL 1.1), normal, bold
	  and CRT-VGA bold, 6x12 to 16x32.

config BR2_PACKAGE_DEBIAN_CONSOLE_FONTS_VGA
	bool "VGA"
	help
	  UniVGA by Dmitry Bolkhovityanov, with the legacy*.bdf
	  supplements made by the console-setup maintainers.

config BR2_PACKAGE_DEBIAN_CONSOLE_FONTS_DEJAVU
	bool "DejaVu"
	help
	  DejaVu Sans Mono (Bitstream Vera, Bitstream Inc.; DejaVu
	  changes public domain) rendered with FreeType on the host
	  (host-freetype and freetype-py), 30x16 up to 118x64, normal
	  and bold. The largest files.

config BR2_PACKAGE_DEBIAN_CONSOLE_FONTS_FIXED
	bool "Fixed"
	help
	  The X11 "misc-fixed" family (public domain; Unicode work by
	  Markus Kuhn), merged per size with BIZNET Poland's ISO 8859-2
	  versions, Efont, ETL and GNU Unifont glyphs.

comment "Code sets (a face is only built for the code sets it covers)"

config BR2_PACKAGE_DEBIAN_CONSOLE_FONTS_UNICODE
	bool "Unicode (Uni1, Uni2, Uni3)"
	default y
	help
	  The 512-glyph Unicode code sets, for UTF-8 consoles.

config BR2_PACKAGE_DEBIAN_CONSOLE_FONTS_LATIN
	bool "Latin1 with Euro (Lat15)"
	help
	  ISO 8859-1, 8859-9 and 8859-15 (Latin-1, Latin-5, Latin-9).

config BR2_PACKAGE_DEBIAN_CONSOLE_FONTS_LATIN2
	bool "Latin2 (Lat2)"

config BR2_PACKAGE_DEBIAN_CONSOLE_FONTS_LATIN7
	bool "Latin7 (Lat7)"

config BR2_PACKAGE_DEBIAN_CONSOLE_FONTS_LATIN38
	bool "Latin3 and Latin8 (Lat38)"

config BR2_PACKAGE_DEBIAN_CONSOLE_FONTS_GREEK
	bool "Greek"

config BR2_PACKAGE_DEBIAN_CONSOLE_FONTS_CYRILLIC
	bool "Cyrillic (CyrSlav, CyrKoi, CyrAsia)"

config BR2_PACKAGE_DEBIAN_CONSOLE_FONTS_ARABIC
	bool "Arabic"

config BR2_PACKAGE_DEBIAN_CONSOLE_FONTS_HEBREW
	bool "Hebrew"

config BR2_PACKAGE_DEBIAN_CONSOLE_FONTS_VIETNAMESE
	bool "Vietnamese"

config BR2_PACKAGE_DEBIAN_CONSOLE_FONTS_ARMENIAN
	bool "Armenian"

config BR2_PACKAGE_DEBIAN_CONSOLE_FONTS_GEORGIAN
	bool "Georgian"

config BR2_PACKAGE_DEBIAN_CONSOLE_FONTS_ETHIOPIAN
	bool "Ethiopian"

config BR2_PACKAGE_DEBIAN_CONSOLE_FONTS_LAO
	bool "Lao"

config BR2_PACKAGE_DEBIAN_CONSOLE_FONTS_THAI
	bool "Thai"

config BR2_PACKAGE_DEBIAN_CONSOLE_FONTS_SCREEN_READER
	bool "Full Greek and Cyrillic (FullGreek, FullCyrSlav, FullCyrAsia)"
	help
	  Uncompressed 512-glyph variants for console screen readers
	  such as speakup or brltty.

endif

comment "debian-console-fonts needs a toolchain w/ gcc >= 4.9"
	depends on BR2_USE_MMU
	depends on !BR2_TOOLCHAIN_GCC_AT_LEAST_4_9
```

## resources/buildrootConf/custom_package/docbook-xsl/Config.in
```kconfig
config BR2_PACKAGE_HOST_DOCBOOK_XSL
	bool "host docbook-xsl"
	select BR2_PACKAGE_HOST_DOCBOOK_XML
	help
	  XML stylesheets for DocBook-XML transformations (the
	  non-namespaced "nons" release, for DocBook 4 sources such as
	  man pages written as <refentry>).

	  This is a host package only: it is installed into the host
	  directory for tools such as xsltproc, and nothing is added to
	  the target root filesystem.

	  A catalog that maps the stylesheet URLs to the installed files
	  is provided, so xsltproc --nonet can find them. Use it with

	      XML_CATALOG_FILES=$(HOST_DOCBOOK_XSL_CATALOG)

	  https://docbook.org

config BR2_PACKAGE_HOST_DOCBOOK_XML
	bool "host docbook-xml"
	help
	  The DocBook XML 4.2 DTD, which DocBook XML sources and the
	  DocBook XSL stylesheets are written against.

	  Selected by host docbook-xsl. Host only: nothing is added to
	  the target root filesystem.

	  https://docbook.org
```

## resources/buildrootConf/custom_package/dotnet10/Config.in
```kconfig
config BR2_PACKAGE_DOTNET10
	bool "dotnet10"
	depends on BR2_x86_64 || BR2_aarch64
	depends on BR2_TOOLCHAIN_USES_GLIBC
	depends on BR2_TOOLCHAIN_BUILDROOT
	depends on BR2_INSTALL_LIBSTDCPP
	depends on BR2_TOOLCHAIN_HAS_THREADS
	depends on BR2_USE_WCHAR
	depends on BR2_USE_MMU
	depends on !BR2_STATIC_LIBS
	select BR2_PACKAGE_CA_CERTIFICATES
	select BR2_PACKAGE_OPENSSL
	select BR2_PACKAGE_ZLIB
	select BR2_PACKAGE_BROTLI
	select BR2_PACKAGE_ICU
	select BR2_TARGET_TZ_INFO
	select BR2_PACKAGE_LINUX_PAM
	select BR2_PACKAGE_GCC_STANDALONE_TOOLCHAIN
	help
	  Microsoft .NET 10 SDK (precompiled linux-x64 / linux-arm64
	  tarball), extracted to /opt/dotnet10. A login shell gets
	  DOTNET_ROOT=/opt/dotnet10 and that directory appended to
	  PATH from /etc/profile.d/dotnet10.sh.

	  Needs glibc: the Microsoft tarballs are not built for
	  musl or uClibc.

	  Kerberos: libgssapi_krb5 comes from MIT Kerberos, not from
	  Linux-PAM, and .NET loads it lazily for Negotiate/NTLM. This
	  package does not select it. Enable the Buildroot krb5 package
	  yourself if you need those.

	  https://dotnet.microsoft.com/

if BR2_PACKAGE_DOTNET10

config BR2_PACKAGE_DOTNET10_VERSION
	string "dotnet10 SDK version"
	default "10.0.401"
	help
	  .NET SDK version, for example 10.0.401. Downloaded from
	  https://builds.dotnet.microsoft.com/dotnet/Sdk/<version>/
	  Leave this unset to use that default.

	  If dotnet10.hash does not yet list that tarball, its
	  sha256 is appended at download time.

endif

comment "dotnet10 needs an x86-64/aarch64 glibc Buildroot toolchain with C++, threads, wchar and dynamic libs"
	depends on BR2_x86_64 || BR2_aarch64
	depends on !BR2_TOOLCHAIN_USES_GLIBC || !BR2_TOOLCHAIN_BUILDROOT || \
		!BR2_INSTALL_LIBSTDCPP || !BR2_TOOLCHAIN_HAS_THREADS || \
		!BR2_USE_WCHAR || BR2_STATIC_LIBS
```

## resources/buildrootConf/custom_package/fdfind/Config.in
```kconfig
config BR2_PACKAGE_FDFIND
	bool "fdfind"
	depends on BR2_PACKAGE_HOST_RUSTC_TARGET_ARCH_SUPPORTS
	depends on BR2_USE_MMU
	select BR2_PACKAGE_HOST_RUSTC
	help
	  sharkdp/fd, a user-friendly find alternative. The crate
	  binary is named fd; this package installs it as
	  /usr/bin/fdfind (a real file, not a symlink) so it does
	  not collide with fdclone.

	  Tag 10.5.0 needs rustc >= 1.90.

	  https://github.com/sharkdp/fd

if BR2_PACKAGE_FDFIND

config BR2_PACKAGE_FDFIND_VERSION
	string "fdfind version (GitHub tag without v)"
	default "10.5.0"
	help
	  GitHub tag from sharkdp/fd without the leading v, for
	  example 10.5.0. Leave this unset to use that default.

	  At download time the tag is checked against
	  https://api.github.com/repos/sharkdp/fd/tags
	  An unknown tag fails the build. If fdfind.hash does not
	  yet list that tag's tarball, its sha256 is appended.

endif

comment "fdfind needs host rustc"
	depends on BR2_USE_MMU
	depends on !BR2_PACKAGE_HOST_RUSTC_TARGET_ARCH_SUPPORTS
```

## resources/buildrootConf/custom_package/gcc-standalone-toolchain/Config.in
```kconfig
config BR2_PACKAGE_GCC_STANDALONE_TOOLCHAIN
	bool "gcc-standalone-toolchain"
	depends on BR2_TOOLCHAIN_BUILDROOT
	depends on BR2_TOOLCHAIN_BUILDROOT_GLIBC || BR2_TOOLCHAIN_BUILDROOT_MUSL || BR2_TOOLCHAIN_BUILDROOT_UCLIBC
	depends on BR2_x86_x86_64 || BR2_x86_x86_64_v2 || BR2_x86_x86_64_v3 || BR2_x86_x86_64_v4 || BR2_aarch64 || BR2_aarch64_be
	help
	  Install a Bootlin prebuilt gcc toolchain into the target
	  rootfs so gcc/g++ are usable on the running image.

	  The tarball is selected from toolchains.bootlin.com using
	  this configuration's CPU variant (x86-64 / x86-64-v2 / v3 /
	  v4, aarch64, aarch64be) and C library (glibc, musl, or
	  uclibc). See https://toolchains.bootlin.com/toolchains.html

	  Requires an internal Buildroot toolchain
	  (BR2_TOOLCHAIN_BUILDROOT).

	  Installed under /opt/gcc-standalone-toolchain on the target
	  image only. Short names (gcc, g++, cc, ld, …) are relative
	  symlinks in that bin directory beside the tuple-prefixed
	  Bootlin binaries. Login shells append that bin directory to
	  PATH. Nothing is written to /usr/bin, so this SDK is never
	  used as the compiler that builds other Buildroot packages.

	  The package makefile appends opt/gcc-standalone-toolchain to
	  BR2_STRIP_EXCLUDE_DIRS so target-finalize does not strip the
	  prebuilt SDK. Kconfig cannot select a string option.

if BR2_PACKAGE_GCC_STANDALONE_TOOLCHAIN

config BR2_PACKAGE_GCC_STANDALONE_TOOLCHAIN_VERSION
	string "Bootlin toolchain release"
	default "2026.08-1"
	help
	  Version suffix from toolchains.bootlin.com, for example
	  2026.08-1. Combined with the selected architecture and C
	  library to form:

	    {arch}--{libc}--stable-{version}.tar.xz

	  Available releases are listed per architecture at
	  https://toolchains.bootlin.com/toolchains.html

endif
```

## resources/buildrootConf/custom_package/groff/Config.in
```kconfig
config BR2_PACKAGE_GROFF
	bool "groff"
	depends on BR2_INSTALL_LIBSTDCPP
	help
	  Groff (GNU troff) is a typesetting system that reads plain text mixed
	  with formatting commands and produces formatted output. Output may be
	  PostScript or PDF, html, or ASCII/UTF8 for display at the terminal.
	  Formatting commands may be either low-level typesetting requests
	  ("primitives") or macros from a supplied set. Users may also write
	  their own macros. All three may be combined.

	  http://www.gnu.org/software/groff/

if BR2_PACKAGE_GROFF

config BR2_PACKAGE_GROFF_VERSION
	string "groff version"
	default "1.24.1"
	help
	  The version of groff to use. This is the version that will be
	  downloaded and built.

endif
```

## resources/buildrootConf/custom_package/hexedit/Config.in
```kconfig
config BR2_PACKAGE_HEXEDIT
	bool "hexedit"
	select BR2_PACKAGE_NCURSES
	help
	  A robust CLI tool to view and edit files in hexadecimal
	  or in ASCII side-by-side.

	  https://github.com/pixel/hexedit

if BR2_PACKAGE_HEXEDIT

config BR2_PACKAGE_HEXEDIT_VERSION
	string "hexedit version (GitHub tag)"
	default "1.6"
	help
	  GitHub tag from pixel/hexedit. Default is 1.6; leave this
	  unset to use that default.

	  At download time the tag is checked against
	  https://api.github.com/repos/pixel/hexedit/tags
	  An unknown tag fails the build. If hexedit.hash does not
	  yet list that tag's tarball, its sha256 is appended.

endif
```

## resources/buildrootConf/custom_package/high-res-font-pack/Config.in
```kconfig
config BR2_PACKAGE_HIGH_RES_FONT_PACK
	bool "high-res-font-pack"
	help
	  Four fixed-width TrueType/OpenType fonts for the kmscon
	  console, installed as plain files, one directory each, under
	  /usr/share/fonts: SourceCodePro, Inconsolata (Nerd Font Mono),
	  FiraMono (Nerd Font Mono) and JetBrains (JetBrains Mono).
	  Only the upright Regular and Bold faces are kept.

	  Nothing is compiled. The archives are Buildroot extra
	  downloads, unpacked in the package's build directory and
	  copied to the target without the faces that are not used.

	  The fonts are only used by kmscon's FreeType renderer, so
	  BR2_PACKAGE_KMSCON, BR2_PACKAGE_FREETYPE and
	  BR2_PACKAGE_FONTCONFIG have to be enabled for them to show.
	  The order in which they are tried is set by font-name in
	  /etc/kmscon/kmscon.conf.

	  All four are licensed under the SIL OFL 1.1.
```

## resources/buildrootConf/custom_package/jaq/Config.in
```kconfig
config BR2_PACKAGE_JAQ
	bool "jaq"
	depends on BR2_PACKAGE_HOST_RUSTC_TARGET_ARCH_SUPPORTS
	depends on BR2_USE_MMU
	select BR2_PACKAGE_HOST_RUSTC
	help
	  jq clone written in Rust (01mf02/jaq). Installs /usr/bin/jaq.

	  When BR2_PACKAGE_JQ is not enabled, /usr/bin/jq is installed
	  as a symlink to jaq so legacy jq invocations still resolve.
	  jaq is mostly, not fully, jq compatible: number handling,
	  some builtins, and error text differ.

	  jaq is independent of BR2_PACKAGE_JQ and may coexist with it.

	  https://github.com/01mf02/jaq

if BR2_PACKAGE_JAQ

config BR2_PACKAGE_JAQ_VERSION
	string "jaq version (GitHub tag without v)"
	default "3.1.1"
	help
	  GitHub tag from 01mf02/jaq without the leading v, for
	  example 3.1.1. Leave this unset to use that default.

	  If jaq.hash does not yet list that tag's tarball, its
	  sha256 is appended at download time.

endif

comment "jaq needs host rustc"
	depends on BR2_USE_MMU
	depends on !BR2_PACKAGE_HOST_RUSTC_TARGET_ARCH_SUPPORTS
```
