## resources/buildrootConf/custom_package/kmscon/Config.in
```kconfig
config BR2_PACKAGE_KMSCON
	bool "kmscon"
	depends on BR2_USE_MMU # fork()
	depends on BR2_TOOLCHAIN_HAS_THREADS # libdrm
	depends on !BR2_STATIC_LIBS # dlopen() font/video modules, shared libtsm
	depends on BR2_PACKAGE_HAS_LIBUDEV # libudev
	select BR2_PACKAGE_FONTCONFIG
	select BR2_PACKAGE_HOST_DOCBOOK_XSL if BR2_KEEP_MAN_PAGES_DOCS
	select BR2_PACKAGE_KMSCON_LIBTSM
	select BR2_PACKAGE_LIBDRM
	select BR2_PACKAGE_LIBXKBCOMMON
	select BR2_PACKAGE_ZLIB
	help
	  KMSCON is a system console terminal emulator for Linux based
	  directly on Kernel Mode Setting (KMS). It replaces the standard
	  kernel VT subsystem entirely in user-space, enabling advanced
	  features like anti-aliased TrueType (TTF) font layouts, 256-color
	  terminal emulation, and localized multi-head environments.

	  KMSCON requires libudev, so you must set either eudev or
	  systemd as your init system to satisfy this requirement.

	  Optional features are enabled automatically when their
	  dependencies are selected: dbus (BR2_PACKAGE_DBUS), libseat
	  (BR2_PACKAGE_KMSCON_LIBSEAT or BR2_PACKAGE_SEATD) and the GPU
	  renderers (a GBM, EGL and GLES provider such as mesa3d).

	  https://github.com/kmscon/kmscon

# libtsm is built by kmscon-libtsm.mk only for kmscon, as the package kmscon-libtsm.
# This has no prompt: it is turned on by kmscon's select and never set by hand.
# Buildroot derives a package's enable symbol from its name, so the package
# name kmscon-libtsm is what makes this BR2_PACKAGE_KMSCON_LIBTSM.
config BR2_PACKAGE_KMSCON_LIBTSM
	bool

if BR2_PACKAGE_KMSCON

config BR2_PACKAGE_KMSCON_VERSION
	string "KMSCON release (tag) version"
	default "10.0.4"
	help
	  KMSCON release without the leading 'v', for example
	  10.0.0. Leave this unset to use that default.

	  See: https://github.com/kmscon/kmscon/releases
	  for more information on release availability.

config BR2_PACKAGE_KMSCON_LIBSEAT
	bool "libseat (seat management)"
	# Buildroot's seatd package already provides libseat
	depends on !BR2_PACKAGE_SEATD
	default y if BR2_PACKAGE_SYSTEMD_LOGIND
	help
	  Build libseat (from seatd's source, client library only) and
	  let KMSCON use it to take its seat and open DRM and input
	  devices without owning the VT. This allows running as a
	  regular user.

	  The backend is chosen from the Buildroot configuration:
	  systemd-logind when BR2_PACKAGE_SYSTEMD_LOGIND is enabled,
	  otherwise libseat's built-in backend (no seat daemon).
	  No seatd daemon is built.

	  Not needed when BR2_PACKAGE_SEATD is enabled: KMSCON then
	  uses the libseat from that package.

config BR2_PACKAGE_KMSCON_LIBSEAT_VERSION
	string "libseat (seatd) release version"
	depends on BR2_PACKAGE_KMSCON_LIBSEAT
	default "0.9.3"
	help
	  seatd release tag whose libseat is built, for example
	  0.9.3. Leave this unset to use that default.

	  See: https://github.com/kennylevinsen/seatd/tags

config BR2_PACKAGE_KMSCON_LIBTSM_VERSION
	string "KMSCON libtsm dependency version"
	default "4.8.0"
	help
	  Specify the version tag of the libtsm terminal emulator
	  library without a leading 'v'. KMSCON 10.x requires
	  libtsm >= 4.8.0.

	  See: https://github.com/kmscon/libtsm/releases

endif

comment "kmscon needs a toolchain w/ threads, dynamic library"
	depends on BR2_USE_MMU
	depends on !BR2_TOOLCHAIN_HAS_THREADS || BR2_STATIC_LIBS

comment "kmscon needs a libudev provider (systemd or eudev)"
	depends on BR2_USE_MMU
	depends on !BR2_PACKAGE_HAS_LIBUDEV
```

## resources/buildrootConf/custom_package/pwsh7/Config.in
```kconfig
config BR2_PACKAGE_PWSH7
	bool "pwsh7"
	depends on BR2_x86_64 || BR2_aarch64
	depends on BR2_TOOLCHAIN_USES_GLIBC
	depends on BR2_TOOLCHAIN_BUILDROOT
	depends on BR2_INSTALL_LIBSTDCPP
	depends on BR2_TOOLCHAIN_HAS_THREADS
	depends on BR2_USE_WCHAR
	depends on BR2_USE_MMU
	depends on !BR2_STATIC_LIBS
	select BR2_PACKAGE_CA_CERTIFICATES
	select BR2_PACKAGE_OPENSSL
	select BR2_PACKAGE_ZLIB
	select BR2_PACKAGE_BROTLI
	select BR2_PACKAGE_ICU
	select BR2_TARGET_TZ_INFO
	select BR2_PACKAGE_LINUX_PAM
	select BR2_PACKAGE_GCC_STANDALONE_TOOLCHAIN
	help
	  PowerShell 7 (precompiled linux-x64 / linux-arm64 tarball
	  from PowerShell/PowerShell GitHub releases), extracted to
	  /opt/pwsh7 with /usr/bin/pwsh pointing at it.

	  The tarball bundles its own .NET runtime, so it does not
	  need BR2_PACKAGE_DOTNET10. PowerShell 7.6 is built on .NET 10.

	  Needs glibc: the Microsoft tarballs are not built for
	  musl or uClibc.

	  https://github.com/PowerShell/PowerShell

if BR2_PACKAGE_PWSH7

config BR2_PACKAGE_PWSH7_VERSION
	string "pwsh7 version (GitHub tag without v)"
	default "7.6.6"
	help
	  PowerShell release without the leading v, for example
	  7.6.6. Leave this unset to use that default.

	  If pwsh7.hash does not yet list that tarball, its sha256
	  is appended at download time.

endif

comment "pwsh7 needs an x86-64/aarch64 glibc Buildroot toolchain with C++, threads, wchar and dynamic libs"
	depends on BR2_x86_64 || BR2_aarch64
	depends on !BR2_TOOLCHAIN_USES_GLIBC || !BR2_TOOLCHAIN_BUILDROOT || \
		!BR2_INSTALL_LIBSTDCPP || !BR2_TOOLCHAIN_HAS_THREADS || \
		!BR2_USE_WCHAR || BR2_STATIC_LIBS
```

## resources/buildrootConf/custom_package/python-freetype-py/Config.in
```kconfig
config BR2_PACKAGE_PYTHON_FREETYPE_PY
	bool "python-freetype-py"
	depends on BR2_PACKAGE_PYTHON3
	select BR2_PACKAGE_FREETYPE
	help
	  Python (ctypes) bindings for FreeType, installed into the
	  target's Python. It loads the target libfreetype at run time.

	  https://github.com/rougier/freetype-py

comment "python-freetype-py needs python3"
	depends on !BR2_PACKAGE_PYTHON3
```

## resources/buildrootConf/custom_package/python-uv/Config.in
```kconfig
config BR2_PACKAGE_PYTHON_UV
	bool "python-uv"
	depends on BR2_PACKAGE_HOST_RUSTC_TARGET_ARCH_SUPPORTS
	depends on BR2_USE_MMU
	select BR2_PACKAGE_HOST_RUSTC
	help
	  uv (astral-sh/uv), a Python package and project manager
	  written in Rust. Installs /usr/bin/uv and /usr/bin/uvx.

	  Independent of BR2_PACKAGE_PYTHON_PIP: both can be enabled.
	  uv is built without the self-update feature.

	  Tag 0.12.23 needs rustc >= 1.97.

	  https://github.com/astral-sh/uv

if BR2_PACKAGE_PYTHON_UV

config BR2_PACKAGE_PYTHON_UV_VERSION
	string "python-uv version (GitHub tag)"
	default "0.12.23"
	help
	  GitHub tag from astral-sh/uv (no v prefix), for example
	  0.12.23. Leave this unset to use that default.

	  If python-uv.hash does not yet list that tag's tarball,
	  its sha256 is appended at download time.

endif

comment "python-uv needs host rustc"
	depends on BR2_USE_MMU
	depends on !BR2_PACKAGE_HOST_RUSTC_TARGET_ARCH_SUPPORTS
```

## resources/buildrootConf/custom_package/sharutils/Config.in
```kconfig
config BR2_PACKAGE_SHARUTILS
	bool "sharutils"
	select BR2_PACKAGE_OPENSSL
	select BR2_PACKAGE_GNUTLS
	select BR2_PACKAGE_GNUTLS_OPENSSL
	help
	  GNU sharutils contains utilities for creating and unpacking
	  shell archives (shars), as well as uuencode and uudecode.

	  http://www.gnu.org/software/sharutils/

if BR2_PACKAGE_SHARUTILS

config BR2_PACKAGE_SHARUTILS_VERSION
	string "sharutils version"
	default "4.9"
	help
	  GNU ftp.gnu.org/gnu/sharutils release, for example 4.9.
	  Leave this unset to use the default.

	  At download time the tarball name is checked on the GNU
	  mirror. If sharutils.hash does not yet list that tarball,
	  its sha256 is appended.

endif
```

## resources/buildrootConf/custom_package/sudo-rs/Config.in
```kconfig
config BR2_PACKAGE_SUDO_RS
	bool "sudo-rs"
	depends on BR2_PACKAGE_HOST_RUSTC_TARGET_ARCH_SUPPORTS
	depends on BR2_USE_MMU
	depends on !BR2_PACKAGE_SUDO
	select BR2_PACKAGE_HOST_RUSTC
	select BR2_PACKAGE_LINUX_PAM
	help
	  Memory-safe sudo and su (trifectatechfoundation/sudo-rs).
	  Installs /usr/bin/sudo and /usr/sbin/su with the setuid bit
	  via SUDO_RS_PERMISSIONS, plus visudo and /etc/sudoers.

	  Mutually exclusive with GNU sudo (BR2_PACKAGE_SUDO).
	  Tag 0.2.15 needs rustc >= 1.85 and linux-pam.

	  https://github.com/trifectatechfoundation/sudo-rs

if BR2_PACKAGE_SUDO_RS

config BR2_PACKAGE_SUDO_RS_VERSION
	string "sudo-rs version (GitHub tag without v)"
	default "0.2.15"
	help
	  GitHub tag from trifectatechfoundation/sudo-rs without the
	  leading v, for example 0.2.15. Leave this unset to use that
	  default.

	  At download time the tag is checked against
	  https://api.github.com/repos/trifectatechfoundation/sudo-rs/tags
	  An unknown tag fails the build. If sudo-rs.hash does not yet
	  list that tag's tarball, its sha256 is appended.

endif

comment "sudo-rs needs host rustc and linux-pam, and conflicts with GNU sudo"
	depends on BR2_USE_MMU
	depends on !BR2_PACKAGE_HOST_RUSTC_TARGET_ARCH_SUPPORTS || \
		BR2_PACKAGE_SUDO
```

## resources/buildrootConf/custom_package/terminus-font/Config.in
```kconfig
config BR2_PACKAGE_TERMINUS_FONT
	bool "terminus-font"
	depends on BR2_USE_MMU
	depends on BR2_TOOLCHAIN_GCC_AT_LEAST_4_9
	select BR2_PACKAGE_KBD
	help
	  Terminus, a clean fixed-width bitmap font, built as Linux
	  console (PSF) fonts and installed gzipped into
	  /usr/share/consolefonts, the directory kbd owns. Only the PSF
	  fonts are built; the X11 (PCF) and OpenType bitmap outputs are
	  skipped, so no X11 tools are needed.

	  Use one with setfont, or set FONT= in /etc/vconsole.conf, for
	  example Uni-Terminus20x10 or Uni-TerminusBold20x10. Names are
	  <Set>-Terminus[Bold|BoldVGA]<height>[x<width>], width omitted
	  when it is 8. Sets: Uni (all), Latin1, Latin2, Greek, Turkish,
	  Cyrillic, Baltic, Latin10, Hebrew, CP437, KOI8R, MIK, PT154, KOI8U.

	  https://terminus-font.sourceforge.net/

if BR2_PACKAGE_TERMINUS_FONT

config BR2_PACKAGE_TERMINUS_FONT_VERSION
	string "terminus-font version"
	default "4.49.1"
	help
	  Terminus release, for example 4.49.1. Leave this unset to use
	  that default.

	  Downloaded from
	  https://downloads.sourceforge.net/project/terminus-font/
	  terminus-font-<major.minor>/terminus-font-<version>.tar.gz
	  where <major.minor> is derived from the version.

endif

comment "terminus-font needs a toolchain w/ gcc >= 4.9"
	depends on BR2_USE_MMU
	depends on !BR2_TOOLCHAIN_GCC_AT_LEAST_4_9
```

## resources/buildrootConf/custom_package/uutils-coreutils/Config.in
```kconfig
config BR2_PACKAGE_UUTILS_COREUTILS
	bool "uutils-coreutils"
	depends on BR2_PACKAGE_HOST_RUSTC_TARGET_ARCH_SUPPORTS
	depends on BR2_USE_MMU
	depends on !BR2_PACKAGE_COREUTILS
	select BR2_PACKAGE_HOST_RUSTC
	help
	  Rust rewrite of GNU coreutils (uutils). Default install is a
	  multicall /usr/bin/coreutils with applets as symlinks
	  (ls, cp, dd, stty, [, ...). BR2_PACKAGE_UUTILS_COREUTILS_INDIVIDUAL_BINARIES
	  installs each applet as its own binary instead.

	  Mutually exclusive with GNU coreutils
	  (BR2_PACKAGE_COREUTILS). Tag 0.12.0 needs rustc >= 1.88.
	  BusyBox is optional: when it is enabled, this package
	  installs after it so ls/cp/dd win over BusyBox applets.

	  chcon and runcon are compiled in when BR2_PACKAGE_LIBSELINUX
	  is already enabled. This package does not depend on
	  libselinux.

	  https://github.com/uutils/coreutils

if BR2_PACKAGE_UUTILS_COREUTILS

config BR2_PACKAGE_UUTILS_COREUTILS_VERSION
	string "uutils-coreutils version (GitHub tag)"
	default "0.12.0"
	help
	  GitHub tag from uutils/coreutils, for example 0.12.0.
	  Leave this unset to use that default.

	  At download time the tag is checked against
	  https://api.github.com/repos/uutils/coreutils/tags
	  An unknown tag fails the build. If uutils-coreutils.hash
	  does not yet list that tag's tarball, its sha256 is appended.

config BR2_PACKAGE_UUTILS_COREUTILS_INDIVIDUAL_BINARIES
	bool "install individual binaries"
	help
	  Install each applet as its own /usr/bin/<applet> file
	  instead of a multicall /usr/bin/coreutils plus symlinks.
	  The [ applet is still installed (as a copy of test).

	  Leave this disabled to keep the multicall binary.

endif

comment "uutils-coreutils needs host rustc, and conflicts with GNU coreutils"
	depends on BR2_USE_MMU
	depends on !BR2_PACKAGE_HOST_RUSTC_TARGET_ARCH_SUPPORTS || \
		BR2_PACKAGE_COREUTILS
```
